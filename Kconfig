## drivers/dw1000/Kconfig
```kconfig
menuconfig RTLS_DW1000
	bool "Driver DW1000 próprio (timestamps de 40 bits para TWR)"
	default y
	depends on DT_HAS_DECAWAVE_DW1000_ENABLED
	depends on !IEEE802154_DW1000
	select SPI
	select GPIO
	help
	  Driver do DW1000 usado pelo RTLS. Usa o mesmo nó de devicetree
	  "decawave,dw1000" da placa, mas não pode coexistir com o driver
	  IEEE 802.15.4 do Zephyr (CONFIG_IEEE802154_DW1000), que converte os
	  timestamps para nanossegundos e perde a precisão necessária ao TWR.

if RTLS_DW1000

config RTLS_DW1000_SPI_FREQ_SLOW
	int "Clock SPI durante a inicialização (Hz)"
	default 2000000
	range 125000 3000000
	help
	  O DW1000 só aceita SPI acima de 3 MHz depois que o PLL trava.
	  Reset, probe e carga do LDE usam este clock; o restante usa o
	  spi-max-frequency do devicetree.

config RTLS_DW1000_TX_ANT_DLY
	int "Atraso de antena de TX (ticks de 15,65 ps)"
	default 16436
	help
	  Valor inicial; calibrar por placa (docs/04-algoritmos.md, seção 3).

config RTLS_DW1000_RX_ANT_DLY
	int "Atraso de antena de RX (ticks de 15,65 ps)"
	default 16436

module = RTLS_DW1000
module-str = rtls_dw1000
source "subsys/logging/Kconfig.template.log_config"

endif # RTLS_DW1000
```

## lib/Kconfig
```kconfig
rsource "common/Kconfig"
rsource "proto/Kconfig"
rsource "twr/Kconfig"
rsource "loc/Kconfig"
rsource "host_if/Kconfig"
```

## lib/common/Kconfig
```kconfig
config RTLS_STATUS_LED
	bool "LEDs de status (heartbeat, atividade UWB, erro)"
	select GPIO
	help
	  Usa os aliases led0 (erro), led1 (heartbeat) e led3 (atividade)
	  do devicetree. Aliases ausentes são ignorados.

config RTLS_STATUS_LED_HEARTBEAT_MS
	int "Meio período do heartbeat (ms)"
	default 500
	depends on RTLS_STATUS_LED

config RTLS_WATCHDOG
	bool "Watchdog da thread main (M8)"
	depends on WATCHDOG
	select HWINFO
	help
	  Liga o watchdog do nRF52 (alias watchdog0) e o alimenta a cada volta
	  do laço da thread main. Se o laço do rádio travar, o nó reinicia. No
	  boot, registra a causa do reset anterior.

config RTLS_WATCHDOG_TIMEOUT_MS
	int "Tempo do watchdog sem alimentação (ms)"
	default 3000
	range 500 60000
	depends on RTLS_WATCHDOG
	help
	  Precisa ser maior que a volta mais longa do laço: na tag sem
	  sincronismo TDMA, ~1 s; no responder da âncora, ~0,5 s.
```

## lib/config/Kconfig
```kconfig
config RTLS_CONFIG_REGISTRY
	bool "Tabela de parâmetros do nó (pura)"
	help
	  Chaves, nomes, faixas e classes dos parâmetros (docs/03, seção 8.2).
	  Sem NVS nem shell: usado também pelos testes em native_sim.

menuconfig RTLS_CONFIG
	bool "Parâmetros do nó na NVS e no shell (M8)"
	depends on SETTINGS
	select RTLS_CONFIG_REGISTRY
	help
	  Os valores do Kconfig viram padrões; o que for gravado pelo shell
	  ("rtls set") fica na NVS (subárvore "rtls/") e vale no próximo boot.

if RTLS_CONFIG

config RTLS_CONFIG_SHELL
	bool "Comandos 'rtls' no shell"
	default y
	depends on SHELL

module = RTLS_CONFIG
module-str = rtls_config
source "subsys/logging/Kconfig.template.log_config"

endif # RTLS_CONFIG
```

## lib/host_if/Kconfig
```kconfig
config RTLS_HOST_IF_CODEC
	bool "Codec do protocolo SPI com o host (puro)"
	select CRC
	help
	  Monta as respostas do protocolo (envelope, INFO, páginas da tabela
	  com CRC-16/CCITT-FALSE) sem acesso ao SPI. Usado pelo transporte e
	  pelos testes em native_sim.

menuconfig RTLS_HOST_IF
	bool "Interface SPI escravo com o host (gateway)"
	depends on SPI_SLAVE
	select RTLS_HOST_IF_CODEC
	help
	  Entrega a tabela de tags a um host externo via SPIS + DRDY
	  (docs/05-interface-spi-gateway.md). Requer no devicetree o chosen
	  "rtls,host-spi" (nó nordic,nrf-spis) e zephyr,user/drdy-gpios.

if RTLS_HOST_IF

config RTLS_HOST_IF_MAX_RECORDS
	int "Registros no snapshot publicado para o host"
	default 64
	range 1 255
	help
	  Tamanho da cópia interna do snapshot (26 B por registro). Precisa
	  cobrir a tabela do gateway mais as tags simuladas.

config RTLS_HOST_IF_STACK_SIZE
	int "Pilha da thread host_if (bytes)"
	default 1024

config RTLS_HOST_IF_THREAD_PRIORITY
	int "Prioridade da thread host_if"
	default -1
	help
	  Negativa = cooperativa, acima da main (prioridade 0). Assim o SPIS é
	  rearmado logo depois de cada transação, sem esperar a main. A thread
	  só faz cópia e CRC de até 245 B por transação e volta a bloquear no
	  spi_transceive().

module = RTLS_HOST_IF
module-str = rtls_host_if
source "subsys/logging/Kconfig.template.log_config"

endif # RTLS_HOST_IF
```

## lib/loc/Kconfig
```kconfig
menuconfig RTLS_LOC
	bool "Localização: multilateração + filtro de Kalman (EKF)"
	help
	  Estimação de posição na tag a partir das distâncias do DS-TWR
	  (docs/04-algoritmos.md, seções 4 e 5). Sem dependência de hardware.

if RTLS_LOC

choice RTLS_LOC_MODE
	prompt "Dimensão da solução"
	default RTLS_LOC_MODE_2D

config RTLS_LOC_MODE_2D
	bool "2D (altura da tag fixa)"

config RTLS_LOC_MODE_3D
	bool "3D (exige ao menos 4 âncoras não coplanares)"

endchoice

config RTLS_LOC_TAG_HEIGHT_MM
	int "Altura fixa da tag no modo 2D (mm)"
	default 1000

config RTLS_LOC_RANGE_STD_MM
	int "Desvio padrão da medida de distância, sigma_r (mm)"
	default 100
	range 1 5000

config RTLS_LOC_ACCEL_STD_MMS2
	int "Desvio padrão da aceleração do modelo, sigma_a (mm/s^2)"
	default 1000
	range 1 100000

config RTLS_LOC_GATE_CHI2_X100
	int "Limiar do gating de inovação (chi-quadrado x 100)"
	default 663
	help
	  663 = 6,63: 99 % para 1 grau de liberdade.

config RTLS_LOC_NLOS_WEIGHTING
	bool "Pondera cada distância pelo indicador de NLOS (P_RX - P_FP)"
	help
	  Aumenta a variância de uma distância quando o primeiro caminho do
	  RESP chega bem abaixo da potência total, sinal de multipercurso ou
	  NLOS (docs/04-algoritmos.md, 5.8). Desligado por padrão para comparar
	  com e sem no ensaio E8.

config RTLS_LOC_NLOS_LOS_DB_X10
	int "Indicador até o qual a distância vale como LOS (dB x 10)"
	default 60

config RTLS_LOC_NLOS_NLOS_DB_X10
	int "Indicador a partir do qual vale o fator máximo (dB x 10)"
	default 100

config RTLS_LOC_NLOS_VAR_GAIN_X10
	int "Fator máximo da variância (x 10)"
	default 90
	range 10 1000
	help
	  90 = variância x 9, ou seja, sigma x 3.

module = RTLS_LOC
module-str = rtls_loc
source "subsys/logging/Kconfig.template.log_config"

endif # RTLS_LOC
```

## lib/proto/Kconfig
```kconfig
config RTLS_PROTO
	bool "Quadros do protocolo RTLS (montagem e parsing)"
	help
	  Codec dos quadros IEEE 802.15.4 + mensagens RTLS descritos em
	  docs/03-protocolo-uwb.md. Sem dependência de hardware.

config RTLS_PAN_ID
	hex "PAN ID da rede RTLS"
	default 0xDECA
	range 0x0000 0xFFFE
	depends on RTLS_PROTO
```

## lib/twr/Kconfig
```kconfig
config RTLS_TWR_MATH
	bool "Matemática do DS-TWR (sem dependência de hardware)"
	help
	  Intervalos com wrap de 40 bits e estimador DS-TWR assimétrico
	  (docs/04-algoritmos.md, seção 2).

menuconfig RTLS_TWR
	bool "Motor DS-TWR (initiator na tag, responder na âncora)"
	depends on RTLS_DW1000
	select RTLS_TWR_MATH
	select RTLS_PROTO

if RTLS_TWR

config RTLS_TWR_REPLY_DELAY_US
	int "Atraso de resposta T_reply (µs)"
	default 1000
	range 300 5000
	help
	  Intervalo entre receber um quadro e transmitir a resposta no
	  primeiro slot. Folgado no início para absorver a latência
	  IRQ -> thread -> SPI; reduzir após medir (M3).

config RTLS_TWR_SLOT_US
	int "Espaçamento entre slots de resposta T_slot (µs)"
	default 1000
	range 500 5000
	help
	  A tag para de esperar RESPs no meio do slot do FINAL. Meio slot
	  precisa cobrir o tempo no ar (~0,2 ms) mais a programação do FINAL.

config RTLS_TWR_RX_MARGIN_US
	int "Margem extra das janelas de RX (µs)"
	default 500
	range 0 5000

config RTLS_TWR_RANGE_BIAS_CORRECTION
	bool "Corrige o viés de distância dependente do nível de sinal (APS011)"
	default y
	help
	  Estima o RSL pela equação de Friis a partir da distância medida
	  (LOS, canal 5) e subtrai a correção interpolada da tabela 2 do
	  APS011 para PRF de 64 MHz. A tabela supõe a calibração de antena
	  feita onde o viés é zero (-77 dBm): 5,0 m com ganho total de 0 dB.

config RTLS_TWR_RANGE_BIAS_GAIN_DB_X10
	int "Ganho das antenas menos perdas, para o cálculo do RSL (dB x 10)"
	default 0
	range -200 200
	depends on RTLS_TWR_RANGE_BIAS_CORRECTION
	help
	  Soma dos ganhos das antenas de TX e RX menos as perdas de PCB, em
	  décimos de dB. 0 trata as antenas como isotrópicas sem perdas
	  (aproximação: o ganho da antena da DWM1001 não foi caracterizado).
	  Se mudar este valor, a distância de calibração passa a ser
	  5,0 m x 10^(G/20).

module = RTLS_TWR
module-str = rtls_twr
source "subsys/logging/Kconfig.template.log_config"

endif # RTLS_TWR
```
