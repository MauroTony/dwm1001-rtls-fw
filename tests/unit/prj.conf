## CMakeLists.txt
```
cmake_minimum_required(VERSION 3.20.0)

find_package(Zephyr REQUIRED HINTS $ENV{ZEPHYR_BASE})
project(rtls_unit_tests)

target_sources(app PRIVATE
  src/test_twr_math.c
  src/test_frames.c
  src/test_loc.c
  src/test_host_if.c
  src/test_tdma.c
  src/test_config.c
)
```

## prj.conf
```kconfig
CONFIG_ZTEST=y
# Os testes do EKF chamam a localização inteira na thread do ztest.
CONFIG_ZTEST_STACK_SIZE=4096
# Mensagens de falha e resumos dos testes com %f.
CONFIG_CBPRINTF_FP_SUPPORT=y

CONFIG_RTLS_TWR_MATH=y
CONFIG_RTLS_PROTO=y
CONFIG_RTLS_LOC=y
CONFIG_RTLS_HOST_IF_CODEC=y
CONFIG_RTLS_CONFIG_REGISTRY=y
```

## boards/decawave_dwm1001_dev.conf
```kconfig
# Na placa, as contas em float usam a FPU do Cortex-M4F, como na tag.
CONFIG_FPU=y
```

## src/test_config.c
```c
/*
 * Testes do registro de parâmetros (M8): T8.0 em docs/08, seção 11. Nos
 * testes só existem os parâmetros das bibliotecas (PAN e EKF); os de cada
 * papel (ID, âncora, antena) entram nos firmwares.
 */

#include <errno.h>

#include <zephyr/ztest.h>

#include <rtls/config.h>

/* T8.0 */
ZTEST(config, test_find_by_name_and_key)
{
	const struct rtls_cfg_param *by_name = rtls_config_find("loc/range_std_mm");
	const struct rtls_cfg_param *by_key = rtls_config_find("0x0603");

	zassert_not_null(by_name);
	zassert_equal_ptr(by_name, by_key);
	zassert_equal(by_name->key, RTLS_CFG_LOC_RANGE_STD);
	zassert_equal(by_name->def, CONFIG_RTLS_LOC_RANGE_STD_MM);

	zassert_is_null(rtls_config_find("loc/nao_existe"));
	zassert_is_null(rtls_config_find("0x9999"));
	zassert_is_null(rtls_config_find("0x06zz"));
	zassert_is_null(rtls_config_find(NULL));

	/* parâmetro de outro papel não aparece neste firmware */
	zassert_is_null(rtls_config_find("anchor/pos_x_mm"));
	zassert_equal(rtls_config_index(RTLS_CFG_ANCHOR_POS_X), -ENOENT);
}

/* T8.0 */
ZTEST(config, test_validate_ranges)
{
	const struct rtls_cfg_param *pan = rtls_config_find("node/pan");
	const struct rtls_cfg_param *std = rtls_config_find("loc/range_std_mm");
	const struct rtls_cfg_param *mode = rtls_config_find("loc/mode_3d");

	zassert_not_null(pan);
	zassert_ok(rtls_config_validate(pan, 0xDECA));
	zassert_equal(rtls_config_validate(pan, 0xFFFF), -ERANGE, "PAN de broadcast");
	zassert_equal(pan->cls, RTLS_CFG_COORD);
	zassert_true(pan->hex);

	zassert_ok(rtls_config_validate(std, 50));
	zassert_equal(rtls_config_validate(std, 0), -ERANGE);
	zassert_equal(rtls_config_validate(std, 5001), -ERANGE);

	zassert_ok(rtls_config_validate(mode, 1));
	zassert_equal(rtls_config_validate(mode, 2), -ERANGE);
}

/* T8.0: chaves únicas e padrões dentro da própria faixa */
ZTEST(config, test_table_is_consistent)
{
	const size_t n = rtls_config_count();

	zassert_true(n > 0);
	zassert_is_null(rtls_config_param(n));

	for (size_t i = 0; i < n; i++) {
		const struct rtls_cfg_param *p = rtls_config_param(i);

		zassert_true(p->def >= p->min && p->def <= p->max, "%s: padrao fora da faixa",
			     p->name);
		zassert_equal(rtls_config_index(p->key), (int)i, "%s: chave repetida", p->name);
		zassert_equal_ptr(rtls_config_find(p->name), p);
	}
}

ZTEST_SUITE(config, NULL, NULL, NULL, NULL, NULL);
```

## src/test_frames.c
```c
/*
 * Testes do codec de quadros (docs/03-protocolo-uwb.md, seção 2).
 */

#include <errno.h>
#include <string.h>

#include <zephyr/ztest.h>

#include <rtls/frames.h>

#define PAN 0xDECA

ZTEST(frames, test_build_and_parse_position)
{
	const struct rtls_msg_position msg = {
		.type = RTLS_MSG_POSITION,
		.round = 42,
		.n_ranges = 4,
		.flags = RTLS_POS_FLAG_VALID,
		.t_ms = 123456,
		.pos_mm = {1500, -250, 1000},
		.std_mm = {30, 35, 0},
	};
	struct rtls_mac_hdr hdr;
	struct rtls_mac_hdr parsed;
	struct rtls_msg_position out;
	uint8_t frame[RTLS_FRAME_MAX_LEN];
	const uint8_t *payload;
	size_t payload_len;
	int len;

	rtls_mac_hdr_init(&hdr, 7, PAN, RTLS_ADDR_GATEWAY, 0x1001);
	len = rtls_frame_build(frame, sizeof(frame), &hdr, &msg, sizeof(msg));
	zassert_equal(len, 9 + 26);

	/* Frame Control no ar: 0x41 0x88. */
	zassert_equal(frame[0], 0x41);
	zassert_equal(frame[1], 0x88);

	zassert_equal(rtls_frame_parse(frame, len, PAN, &parsed, &payload, &payload_len),
		      RTLS_MSG_POSITION);
	zassert_equal(parsed.src, 0x1001);
	zassert_equal(parsed.dst, RTLS_ADDR_GATEWAY);
	zassert_equal(parsed.seq, 7);
	zassert_equal(payload_len, sizeof(out));

	memcpy(&out, payload, sizeof(out));
	zassert_mem_equal(&out, &msg, sizeof(msg));
}

ZTEST(frames, test_parse_rejects_wrong_pan_and_short_payload)
{
	const struct rtls_msg_report report = {.type = RTLS_MSG_REPORT};
	struct rtls_mac_hdr hdr;
	struct rtls_mac_hdr parsed;
	uint8_t frame[RTLS_FRAME_MAX_LEN];
	const uint8_t *payload;
	size_t payload_len;
	int len;

	rtls_mac_hdr_init(&hdr, 0, PAN, 0x1001, 0xA001);
	len = rtls_frame_build(frame, sizeof(frame), &hdr, &report, sizeof(report));
	zassert_true(len > 0);

	zassert_equal(rtls_frame_parse(frame, len, 0x1234, &parsed, &payload, &payload_len),
		      -EBADMSG, "PAN diferente deve ser rejeitado");
	zassert_equal(rtls_frame_parse(frame, len - 1, PAN, &parsed, &payload, &payload_len),
		      -EBADMSG, "payload menor que o tipo deve ser rejeitado");
}

ZTEST(frames, test_build_rejects_oversized_frame)
{
	uint8_t big[RTLS_FRAME_MAX_LEN] = {RTLS_MSG_POSITION};
	struct rtls_mac_hdr hdr;
	uint8_t frame[RTLS_FRAME_MAX_LEN];

	rtls_mac_hdr_init(&hdr, 0, PAN, RTLS_ADDR_BROADCAST, 0x1001);
	zassert_equal(rtls_frame_build(frame, sizeof(frame), &hdr, big, sizeof(big)), -ENOMEM);
}

ZTEST(frames, test_message_sizes)
{
	zassert_equal(rtls_msg_size(RTLS_MSG_POLL), 11);
	zassert_equal(rtls_msg_size(RTLS_MSG_REPORT), 24);
	zassert_equal(rtls_msg_size(RTLS_MSG_POSITION), 26);
	zassert_equal(rtls_msg_size(RTLS_MSG_PING), 5);
	zassert_equal(rtls_msg_size(0x99), 0);

	/* O maior quadro (POSITION) cabe com folga no limite de 127 B. */
	zassert_true(sizeof(struct rtls_mac_hdr) + sizeof(struct rtls_msg_position) +
			     RTLS_FCS_LEN <= RTLS_FRAME_MAX_LEN);
}

/* T5.0: lacunas de round no gateway */
ZTEST(frames, test_round_tracker)
{
	struct rtls_round_tracker trk = {0};

	/* primeiro quadro e consecutivos: sem perda */
	zassert_equal(rtls_round_tracker_update(&trk, 10, 1000), 0);
	zassert_equal(rtls_round_tracker_update(&trk, 11, 1100), 0);

	/* rodadas 12 e 13 sem POSITION */
	zassert_equal(rtls_round_tracker_update(&trk, 14, 1400), 2);

	/* repetido: ignorado, sem mexer na sequência */
	zassert_equal(rtls_round_tracker_update(&trk, 14, 1400), -EALREADY);
	zassert_equal(rtls_round_tracker_update(&trk, 15, 1500), 0);

	/* volta do contador de 8 bits: 254 -> 1 perde 255 e 0 */
	trk = (struct rtls_round_tracker){0};
	zassert_equal(rtls_round_tracker_update(&trk, 254, 50000), 0);
	zassert_equal(rtls_round_tracker_update(&trk, 1, 50300), 2);

	/* tag reiniciou (t_ms voltou): recomeça sem contar perdas */
	zassert_equal(rtls_round_tracker_update(&trk, 0, 120), 0);
	zassert_equal(rtls_round_tracker_update(&trk, 1, 220), 0);
}

ZTEST_SUITE(frames, NULL, NULL, NULL, NULL, NULL);
```

## src/test_host_if.c
```c
/*
 * Testes do codec do protocolo SPI com o host (docs/05-interface-spi-gateway.md,
 * seções 2 e 3): T6.0 em docs/08, seção 9.
 */

#include <string.h>

#include <zephyr/sys/byteorder.h>
#include <zephyr/ztest.h>

#include <rtls/frames.h>
#include <rtls/host_if.h>

static const struct rtls_host_if_info info = {
	.fw_version = {0, 6, 1},
	.gateway_id = 0x0001,
	.capacity = 16,
	.superframe_ms = 100,
};

static struct rtls_tag_record records[20];
static uint8_t rsp[RTLS_HOST_IF_MAX_XFER];

static void fill_records(void)
{
	for (int i = 0; i < ARRAY_SIZE(records); i++) {
		records[i] = (struct rtls_tag_record){
			.tag_id = 0x1001 + i,
			.round = (uint8_t)(10 * i),
			.n_ranges = 4,
			.flags = RTLS_POS_FLAG_VALID,
			.rssi_dbm = -80,
			.age_ms = (uint16_t)(5 * i),
			.pos_mm = {1000 * i, -250 * i, 1000},
			.std_mm = {30, 35, 0},
		};
	}
}

static struct rtls_host_if_view view_of(size_t count, uint8_t snapshot)
{
	return (struct rtls_host_if_view){
		.info = &info,
		.records = records,
		.count = count,
		.snapshot = snapshot,
	};
}

/* Request de TAGS_GET como o host ESP32 manda: TLV + 0xFF até 16 bytes. */
static size_t tags_get(const struct rtls_host_if_view *view, uint8_t page,
		       struct rtls_host_if_event *ev)
{
	uint8_t req[16];

	memset(req, 0xFF, sizeof(req));
	req[0] = RTLS_HOST_IF_REQ_TAGS_GET;
	req[1] = 1;
	req[2] = page;
	return rtls_host_if_handle(req, sizeof(req), view, rsp, ev);
}

/* Confere envelope, TLV 0xB1, cabeçalho da página, registros e CRC. */
static void check_page(size_t rsp_len, uint8_t page, uint8_t n_pages, uint8_t count,
		       uint8_t snapshot, size_t first)
{
	const uint8_t *v = &rsp[5];
	const size_t value_len = 4 + 26 * count + 2;

	zassert_equal(rsp_len, 5 + value_len);
	zassert_equal(rsp[0], RTLS_HOST_IF_RSP_ENVELOPE);
	zassert_equal(rsp[1], 1);
	zassert_equal(rsp[2], RTLS_HOST_IF_ST_OK);
	zassert_equal(rsp[3], RTLS_HOST_IF_RSP_TAGS);
	zassert_equal(rsp[4], value_len);
	zassert_equal(v[0], page);
	zassert_equal(v[1], n_pages);
	zassert_equal(v[2], count);
	zassert_equal(v[3], snapshot);
	zassert_mem_equal(&v[4], &records[first], 26 * count);
	zassert_equal(sys_get_le16(&v[value_len - 2]), rtls_host_if_crc(v, value_len - 2));
}

/* T6.0 */
ZTEST(host_if, test_crc_known_vector)
{
	/* CRC-16/CCITT-FALSE do texto padrão "123456789" */
	zassert_equal(rtls_host_if_crc((const uint8_t *)"123456789", 9), 0x29B1);
}

/* T6.0 */
ZTEST(host_if, test_page_count)
{
	zassert_equal(rtls_host_if_n_pages(0), 1);
	zassert_equal(rtls_host_if_n_pages(1), 1);
	zassert_equal(rtls_host_if_n_pages(9), 1);
	zassert_equal(rtls_host_if_n_pages(10), 2);
	zassert_equal(rtls_host_if_n_pages(19), 3);
	zassert_equal(rtls_host_if_n_pages(255 * 9 + 1), 255);
}

/* T6.0 */
ZTEST(host_if, test_info_get)
{
	const struct rtls_host_if_view view = view_of(3, 7);
	const uint8_t req[] = {RTLS_HOST_IF_REQ_INFO_GET, 0, 0xFF, 0xFF};
	struct rtls_host_if_event ev;
	const uint8_t expected[] = {
		0x40, 0x01, 0x00,             /* envelope OK */
		0xB0, 11,                     /* TLV INFO */
		1,    0,    6,    1,          /* protocolo, firmware 0.6.1 */
		0x01, 0x00,                   /* ID do gateway */
		16,   3,                      /* capacidade, tags ativas */
		100,  0,                      /* superquadro (ms) */
		9,                            /* registros por página */
	};

	zassert_equal(rtls_host_if_handle(req, sizeof(req), &view, rsp, &ev), sizeof(expected));
	zassert_mem_equal(rsp, expected, sizeof(expected));
	zassert_equal(ev.drdy_enable, -1);
	zassert_false(ev.last_page);
}

/* T6.0: 20 tags em 3 páginas, a última marcada */
ZTEST(host_if, test_tags_pages)
{
	const struct rtls_host_if_view view = view_of(20, 42);
	struct rtls_host_if_event ev;
	size_t len;

	fill_records();

	len = tags_get(&view, 0, &ev);
	check_page(len, 0, 3, 9, 42, 0);
	zassert_equal(len, 245, "página cheia deve ter 245 B");
	zassert_false(ev.last_page);

	len = tags_get(&view, 1, &ev);
	check_page(len, 1, 3, 9, 42, 9);
	zassert_false(ev.last_page);

	len = tags_get(&view, 2, &ev);
	check_page(len, 2, 3, 2, 42, 18);
	zassert_true(ev.last_page);

	/* página fora da faixa */
	zassert_equal(tags_get(&view, 3, &ev), 3);
	zassert_equal(rsp[2], RTLS_HOST_IF_ST_INVALID);
	zassert_false(ev.last_page);
}

/* T6.0: tabela vazia ainda tem uma página, sem registros */
ZTEST(host_if, test_tags_empty)
{
	const struct rtls_host_if_view view = view_of(0, 1);
	struct rtls_host_if_event ev;

	check_page(tags_get(&view, 0, &ev), 0, 1, 0, 1, 0);
	zassert_true(ev.last_page);

	zassert_equal(tags_get(&view, 1, &ev), 3);
	zassert_equal(rsp[2], RTLS_HOST_IF_ST_INVALID);
}

/* T6.0 */
ZTEST(host_if, test_drdy_cfg_set)
{
	const struct rtls_host_if_view view = view_of(0, 0);
	const uint8_t off[] = {RTLS_HOST_IF_REQ_DRDY_CFG_SET, 1, 0};
	const uint8_t bad[] = {RTLS_HOST_IF_REQ_DRDY_CFG_SET, 1, 2};
	struct rtls_host_if_event ev;

	zassert_equal(rtls_host_if_handle(off, sizeof(off), &view, rsp, &ev), 3);
	zassert_equal(rsp[2], RTLS_HOST_IF_ST_OK);
	zassert_equal(ev.drdy_enable, 0);

	zassert_equal(rtls_host_if_handle(bad, sizeof(bad), &view, rsp, &ev), 3);
	zassert_equal(rsp[2], RTLS_HOST_IF_ST_INVALID);
	zassert_equal(ev.drdy_enable, -1);
}

/* T6.0: NOP, transação vazia, opcode desconhecido e TLV truncado */
ZTEST(host_if, test_errors_and_nop)
{
	const struct rtls_host_if_view view = view_of(0, 0);
	const uint8_t nop[] = {0xFF};
	const uint8_t unknown[] = {0x55, 0};
	const uint8_t truncated[] = {RTLS_HOST_IF_REQ_TAGS_GET, 1};
	const uint8_t info_with_value[] = {RTLS_HOST_IF_REQ_INFO_GET, 1, 0};
	struct rtls_host_if_event ev;

	zassert_equal(rtls_host_if_handle(nop, sizeof(nop), &view, rsp, &ev), 0);
	zassert_equal(rtls_host_if_handle(nop, 0, &view, rsp, &ev), 0);

	zassert_equal(rtls_host_if_handle(unknown, sizeof(unknown), &view, rsp, &ev), 3);
	zassert_equal(rsp[2], RTLS_HOST_IF_ST_UNKNOWN);

	zassert_equal(rtls_host_if_handle(truncated, sizeof(truncated), &view, rsp, &ev), 3);
	zassert_equal(rsp[2], RTLS_HOST_IF_ST_INVALID);

	zassert_equal(rtls_host_if_handle(info_with_value, sizeof(info_with_value), &view, rsp,
					  &ev),
		      3);
	zassert_equal(rsp[2], RTLS_HOST_IF_ST_INVALID);
}

ZTEST_SUITE(host_if, NULL, NULL, NULL, NULL, NULL);
```

## src/test_loc.c
```c
/*
 * Testes da localização (docs/04-algoritmos.md, seções 4 e 5): matrizes,
 * multilateração e EKF com trajetórias sintéticas. IDs em docs/08, seção 7.
 */

#include <errno.h>
#include <math.h>

#include <zephyr/sys/util.h>
#include <zephyr/ztest.h>

#include <rtls/frames.h>
#include <rtls/loc.h>
#include <rtls/loc_mat.h>

#define TAG_Z_M  1.0f
#define CYCLE_MS 100

/* Sala de 8 x 6 m, âncoras no teto (coplanares): o caso 2D do sistema. */
static const int32_t anchors_2d[4][3] = {
	{0, 0, 2500}, {8000, 0, 2500}, {8000, 6000, 2500}, {0, 6000, 2500},
};

/* Alturas alternadas: geometria 3D bem condicionada. */
static const int32_t anchors_3d[4][3] = {
	{0, 0, 500}, {8000, 0, 2500}, {8000, 6000, 500}, {0, 6000, 2500},
};

static struct rtls_loc_ctx ctx;

/* Gerador determinístico (xorshift32) + Box-Muller: mesmo resultado em toda plataforma. */
static uint32_t rng_state;

static void rng_seed(uint32_t seed)
{
	rng_state = seed ? seed : 1U;
}

static float rng_uniform(void)
{
	rng_state ^= rng_state << 13;
	rng_state ^= rng_state >> 17;
	rng_state ^= rng_state << 5;
	return ((float)(rng_state >> 8) + 0.5f) / 16777216.0f;
}

static float rng_gauss(float std)
{
	const float u1 = rng_uniform();
	const float u2 = rng_uniform();

	return std * sqrtf(-2.0f * logf(u1)) * cosf(6.2831853f * u2);
}

static struct rtls_loc_cfg cfg_2d(float range_std_m)
{
	struct rtls_loc_cfg cfg = {
		.dim = RTLS_LOC_2D,
		.tag_height_m = TAG_Z_M,
		.range_std_m = range_std_m,
		.accel_std_mps2 = 1.0f,
		.gate_chi2 = 6.63f,
	};

	return cfg;
}

/*
 * Monta uma rodada com as âncoras de @p mask (bit i = âncora i). A distância é
 * a verdadeira (tag em @p p, z = p[2]) + ruído gaussiano; @p outlier_idx >= 0
 * soma 1 m nessa âncora.
 */
static void make_set(struct rtls_range_set *set, const int32_t anchors[4][3], const float p[3],
		     int64_t t_ms, uint8_t mask, float noise_std, int outlier_idx)
{
	set->round = (uint8_t)(t_ms / CYCLE_MS);
	set->t_ms = t_ms;
	set->count = 0;

	for (int i = 0; i < 4; i++) {
		struct rtls_range *r;
		float d2 = 0.0f;

		if (!(mask & BIT(i))) {
			continue;
		}

		r = &set->ranges[set->count++];
		r->anchor_id = 0xA001 + i;
		for (int j = 0; j < 3; j++) {
			const float dj = p[j] - (float)anchors[i][j] / 1000.0f;

			r->anchor_pos_mm[j] = anchors[i][j];
			d2 += dj * dj;
		}
		r->distance_m = sqrtf(d2) + rng_gauss(noise_std);
		if (i == outlier_idx) {
			r->distance_m += 1.0f;
		}
		r->distance_raw_m = r->distance_m;
		r->rx_power_cdbm = (int16_t)(-6300 - (int)(200.0f * sqrtf(d2)));
		r->resp_fp_power_cdbm = r->rx_power_cdbm; /* indicador de NLOS = 0 dB */
		r->fp_power_cdbm = r->rx_power_cdbm;
	}
}

static float err_2d(const struct rtls_position *pos, const float p[3])
{
	const float dx = pos->pos_m[0] - p[0];
	const float dy = pos->pos_m[1] - p[1];

	return sqrtf(dx * dx + dy * dy);
}

/* ---------------------------------------------------------------- matrizes */

/* T4.14 */
ZTEST(loc_mat, test_mul_and_mul_bt)
{
	struct rtls_mat a, b, c;

	rtls_mat_zero(&a, 2, 3);
	rtls_mat_zero(&b, 3, 2);
	for (int i = 0; i < 2; i++) {
		for (int j = 0; j < 3; j++) {
			a.a[i][j] = (float)(1 + 3 * i + j); /* [1 2 3; 4 5 6] */
			b.a[j][i] = (float)(1 + 3 * i + j); /* a^T */
		}
	}

	zassert_ok(rtls_mat_mul(&c, &a, &b));
	zassert_equal(c.rows, 2);
	zassert_equal(c.cols, 2);
	zassert_within(c.a[0][0], 14.0f, 1e-6f);
	zassert_within(c.a[0][1], 32.0f, 1e-6f);
	zassert_within(c.a[1][1], 77.0f, 1e-6f);

	/* a a^T pelo segundo fator transposto dá o mesmo resultado */
	zassert_ok(rtls_mat_mul_bt(&c, &a, &a));
	zassert_within(c.a[1][0], 32.0f, 1e-6f);

	zassert_equal(rtls_mat_mul(&c, &a, &a), -EINVAL);
}

/* T4.14 */
ZTEST(loc_mat, test_cholesky_inverse)
{
	struct rtls_mat a, inv, prod;
	const float m[3][3] = {{4.0f, 2.0f, 0.4f}, {2.0f, 5.0f, 1.0f}, {0.4f, 1.0f, 3.0f}};

	rtls_mat_zero(&a, 3, 3);
	for (int i = 0; i < 3; i++) {
		for (int j = 0; j < 3; j++) {
			a.a[i][j] = m[i][j];
		}
	}

	zassert_ok(rtls_mat_inv_spd(&inv, &a));
	zassert_ok(rtls_mat_mul(&prod, &a, &inv));
	for (int i = 0; i < 3; i++) {
		for (int j = 0; j < 3; j++) {
			zassert_within(prod.a[i][j], (i == j) ? 1.0f : 0.0f, 1e-5f);
		}
	}
	zassert_within(rtls_mat_trace(&a), 12.0f, 1e-6f);
}

/* T4.14 */
ZTEST(loc_mat, test_cholesky_rejects_singular)
{
	struct rtls_mat a, l;

	/* posto 1: u u^T */
	rtls_mat_zero(&a, 2, 2);
	a.a[0][0] = 1.0f;
	a.a[0][1] = 2.0f;
	a.a[1][0] = 2.0f;
	a.a[1][1] = 4.0f;
	zassert_equal(rtls_mat_cholesky(&l, &a), -EDOM);

	/* indefinida */
	a.a[1][1] = -1.0f;
	zassert_equal(rtls_mat_cholesky(&l, &a), -EDOM);

	rtls_mat_zero(&a, 2, 2);
	zassert_equal(rtls_mat_cholesky(&l, &a), -EDOM);
}

ZTEST_SUITE(loc_mat, NULL, NULL, NULL, NULL, NULL);

/* ---------------------------------------------------------- multilateração */

/* T4.1 */
ZTEST(loc, test_multilat_exact_2d)
{
	const struct rtls_loc_cfg cfg = cfg_2d(0.05f);
	const float truth[3] = {2.7f, 4.1f, TAG_Z_M};
	struct rtls_range_set set;
	float pos[3], gdop;

	make_set(&set, anchors_2d, truth, 0, 0xF, 0.0f, -1);
	zassert_ok(rtls_loc_multilaterate(&cfg, &set, pos, &gdop));
	zassert_within(pos[0], truth[0], 1e-3f);
	zassert_within(pos[1], truth[1], 1e-3f);
	zassert_within(pos[2], TAG_Z_M, 1e-6f);
	zassert_true(gdop > 0.5f && gdop < 3.0f, "GDOP %f", (double)gdop);

	/* 3 âncoras bastam em 2D */
	make_set(&set, anchors_2d, truth, 0, 0x7, 0.0f, -1);
	zassert_ok(rtls_loc_multilaterate(&cfg, &set, pos, NULL));
	zassert_within(pos[0], truth[0], 1e-3f);
	zassert_within(pos[1], truth[1], 1e-3f);
}

/* T4.1 */
ZTEST(loc, test_multilat_exact_3d)
{
	struct rtls_loc_cfg cfg = cfg_2d(0.05f);
	const float truth[3] = {5.2f, 1.9f, 1.3f};
	struct rtls_range_set set;
	float pos[3], gdop;

	cfg.dim = RTLS_LOC_3D;
	make_set(&set, anchors_3d, truth, 0, 0xF, 0.0f, -1);
	zassert_ok(rtls_loc_multilaterate(&cfg, &set, pos, &gdop));
	for (int i = 0; i < 3; i++) {
		zassert_within(pos[i], truth[i], 1e-3f, "eixo %d: %f", i, (double)pos[i]);
	}
	zassert_true(gdop > 0.5f && isfinite(gdop));
}

/* T4.2 */
ZTEST(loc, test_multilat_degenerate)
{
	static const int32_t collinear[4][3] = {
		{0, 0, 2500}, {3000, 0, 2500}, {6000, 0, 2500}, {9000, 0, 2500},
	};
	struct rtls_loc_cfg cfg = cfg_2d(0.05f);
	const float truth[3] = {2.0f, 3.0f, TAG_Z_M};
	struct rtls_range_set set;
	float pos[3];

	make_set(&set, collinear, truth, 0, 0xF, 0.0f, -1);
	zassert_equal(rtls_loc_multilaterate(&cfg, &set, pos, NULL), -EINVAL);

	/* poucas distâncias: 2 em 2D, 3 em 3D */
	make_set(&set, anchors_2d, truth, 0, 0x3, 0.0f, -1);
	zassert_equal(rtls_loc_multilaterate(&cfg, &set, pos, NULL), -EINVAL);
	cfg.dim = RTLS_LOC_3D;
	make_set(&set, anchors_3d, truth, 0, 0x7, 0.0f, -1);
	zassert_equal(rtls_loc_multilaterate(&cfg, &set, pos, NULL), -EINVAL);

	/* 3D com âncoras coplanares (todas no teto) */
	make_set(&set, anchors_2d, truth, 0, 0xF, 0.0f, -1);
	zassert_equal(rtls_loc_multilaterate(&cfg, &set, pos, NULL), -EINVAL);
}

/* --------------------------------------------------------------------- EKF */

/* RMSE 2D de uma tag parada, a partir da rodada 20. */
static float run_static(float noise_std, int outlier_every, uint32_t *n_injected,
			uint32_t *n_flagged)
{
	const struct rtls_loc_cfg cfg = cfg_2d(noise_std);
	const float truth[3] = {3.0f, 2.0f, TAG_Z_M};
	float sum = 0.0f;
	int n = 0;

	*n_injected = 0;
	*n_flagged = 0;
	zassert_ok(rtls_loc_init(&ctx, &cfg));
	for (int k = 0; k < 300; k++) {
		const bool outlier = outlier_every > 0 && k >= 10 && k % outlier_every == 5;
		struct rtls_range_set set;
		struct rtls_position pos;
		float e;

		make_set(&set, anchors_2d, truth, (int64_t)k * CYCLE_MS, 0xF, noise_std,
			 outlier ? 2 : -1);
		zassert_ok(rtls_loc_update(&ctx, &set, &pos));
		zassert_true(pos.flags & RTLS_POS_FLAG_VALID);
		if (outlier) {
			(*n_injected)++;
			*n_flagged += (pos.flags & RTLS_POS_FLAG_OUTLIER) ? 1 : 0;
		}

		e = err_2d(&pos, truth);
		if (k >= 20) {
			sum += e * e;
			n++;
		}
	}

	return sqrtf(sum / n);
}

/* T4.3 */
ZTEST(loc, test_ekf_static)
{
	const struct rtls_loc_cfg cfg = cfg_2d(0.05f);
	const float truth[3] = {3.0f, 2.0f, TAG_Z_M};
	struct rtls_position pos;
	struct rtls_range_set set;
	uint32_t inj, flg;
	float rmse;

	rng_seed(1);
	rmse = run_static(0.05f, 0, &inj, &flg);
	zassert_true(rmse <= 0.05f, "RMSE %f m", (double)rmse);
	TC_PRINT("T4.3 parado, sigma 5 cm: RMSE %.1f mm\n", (double)(rmse * 1000.0f));

	/* a primeira rodada sai da multilateração */
	zassert_ok(rtls_loc_init(&ctx, &cfg));
	make_set(&set, anchors_2d, truth, 0, 0xF, 0.05f, -1);
	zassert_ok(rtls_loc_update(&ctx, &set, &pos));
	zassert_true(pos.flags & RTLS_POS_FLAG_INIT);
	zassert_equal(pos.n_ranges, 4);
	zassert_false(pos.flags & RTLS_POS_FLAG_3D);
	zassert_within(pos.pos_m[2], TAG_Z_M, 1e-6f);
}

/* T4.4 */
ZTEST(loc, test_ekf_straight_line)
{
	const struct rtls_loc_cfg cfg = cfg_2d(0.05f);
	const float p0[2] = {1.0f, 1.0f};
	const float u[2] = {0.8320503f, 0.5547002f}; /* direção (6, 4) normalizada */
	float sum = 0.0f;
	int n = 0;

	rng_seed(2);
	zassert_ok(rtls_loc_init(&ctx, &cfg));
	for (int k = 0; k < 72; k++) {
		/* 1 m/s = 0,1 m por ciclo */
		const float truth[3] = {p0[0] + 0.1f * k * u[0], p0[1] + 0.1f * k * u[1], TAG_Z_M};
		struct rtls_range_set set;
		struct rtls_position pos;
		float e;

		make_set(&set, anchors_2d, truth, (int64_t)k * CYCLE_MS, 0xF, 0.05f, -1);
		zassert_ok(rtls_loc_update(&ctx, &set, &pos));
		e = err_2d(&pos, truth);
		if (k >= 20) {
			sum += e * e;
			n++;
		}
	}

	zassert_true(sqrtf(sum / n) <= 0.10f, "RMSE %f m", (double)sqrtf(sum / n));
	TC_PRINT("T4.4 reta a 1 m/s: RMSE %.1f mm\n", (double)(sqrtf(sum / n) * 1000.0f));
}

/* T4.5 */
ZTEST(loc, test_ekf_rejects_outliers)
{
	struct rtls_loc_stats st;
	uint32_t inj, flg;
	float clean, dirty;

	rng_seed(3);
	clean = run_static(0.05f, 0, &inj, &flg);
	rng_seed(3);
	dirty = run_static(0.05f, 10, &inj, &flg);
	rtls_loc_get_stats(&ctx, &st, false);

	zassert_true(inj >= 25, "outliers injetados: %u", inj);
	zassert_equal(flg, inj, "flag OUTLIER em %u de %u", flg, inj);
	zassert_true(st.rejected >= inj);
	zassert_equal(st.resets, 0);
	zassert_true(dirty <= 1.1f * clean + 0.005f, "RMSE %f com, %f sem", (double)dirty,
		     (double)clean);
	TC_PRINT("T4.5 +1 m em 10%%: %u rejeitadas (%u injetadas), RMSE %.1f x %.1f mm\n",
		 st.rejected, inj, (double)(dirty * 1000.0f), (double)(clean * 1000.0f));
}

/* T4.6 */
ZTEST(loc, test_ekf_two_ranges)
{
	const struct rtls_loc_cfg cfg = cfg_2d(0.05f);
	const float truth[3] = {3.0f, 2.0f, TAG_Z_M};
	struct rtls_loc_stats st;
	struct rtls_position pos;
	float worst = 0.0f;

	rng_seed(4);
	zassert_ok(rtls_loc_init(&ctx, &cfg));
	for (int k = 0; k < 130; k++) {
		const bool two = k >= 30 && k < 80;
		struct rtls_range_set set;

		make_set(&set, anchors_2d, truth, (int64_t)k * CYCLE_MS, two ? 0x3 : 0xF, 0.05f,
			 -1);
		zassert_ok(rtls_loc_update(&ctx, &set, &pos));
		if (two) {
			worst = fmaxf(worst, err_2d(&pos, truth));
		}
	}

	rtls_loc_get_stats(&ctx, &st, false);
	zassert_equal(st.resets, 0);
	zassert_true(worst < 0.30f, "pior erro com 2 distancias %f m", (double)worst);
	zassert_true(err_2d(&pos, truth) < 0.10f);
}

/* T4.7 */
ZTEST(loc, test_ekf_nees)
{
	const struct rtls_loc_cfg cfg = cfg_2d(0.05f);
	const float dt = CYCLE_MS / 1000.0f;
	const int runs = 100;
	const int steps = 100;
	float nees_sum = 0.0f;
	int nees_n = 0;

	rng_seed(5);
	for (int run = 0; run < runs; run++) {
		/* verdade gerada pelo próprio modelo: aceleração branca de sigma_a */
		float x[4] = {4.0f, 3.0f, 0.0f, 0.0f};

		zassert_ok(rtls_loc_init(&ctx, &cfg));
		for (int k = 0; k < steps; k++) {
			const float truth[3] = {x[0], x[1], TAG_Z_M};
			struct rtls_range_set set;
			struct rtls_position pos;
			struct rtls_mat pinv;
			float e[4], s = 0.0f;

			make_set(&set, anchors_2d, truth, (int64_t)k * CYCLE_MS, 0xF, 0.05f, -1);
			zassert_ok(rtls_loc_update(&ctx, &set, &pos));

			if (k >= 20) {
				zassert_ok(rtls_mat_inv_spd(&pinv, &ctx.P));
				for (int i = 0; i < 4; i++) {
					e[i] = ctx.x[i] - x[i];
				}
				for (int i = 0; i < 4; i++) {
					for (int j = 0; j < 4; j++) {
						s += e[i] * pinv.a[i][j] * e[j];
					}
				}
				nees_sum += s;
				nees_n++;
			}

			for (int ax = 0; ax < 2; ax++) {
				const float w = rng_gauss(cfg.accel_std_mps2);

				x[ax] += dt * x[2 + ax] + 0.5f * dt * dt * w;
				x[2 + ax] += dt * w;
			}
		}
	}

	zassert_true(nees_sum / nees_n > 3.4f && nees_sum / nees_n < 4.8f, "NEES medio %f",
		     (double)(nees_sum / nees_n));
	TC_PRINT("T4.7 NEES medio %.2f (4 estados)\n", (double)(nees_sum / nees_n));
}

/* T4.12 */
ZTEST(loc, test_ekf_reinit_after_timeout)
{
	const struct rtls_loc_cfg cfg = cfg_2d(0.05f);
	const float truth[3] = {3.0f, 2.0f, TAG_Z_M};
	struct rtls_range_set set;
	struct rtls_position pos;
	struct rtls_loc_stats st;
	int64_t t = 0;

	rng_seed(6);
	zassert_ok(rtls_loc_init(&ctx, &cfg));
	for (int k = 0; k < 20; k++, t += CYCLE_MS) {
		make_set(&set, anchors_2d, truth, t, 0xF, 0.05f, -1);
		zassert_ok(rtls_loc_update(&ctx, &set, &pos));
	}
	zassert_false(pos.flags & RTLS_POS_FLAG_INIT);

	/* 1,5 s sem rodadas */
	make_set(&set, anchors_2d, truth, t + 1500, 0xF, 0.05f, -1);
	zassert_ok(rtls_loc_update(&ctx, &set, &pos));
	rtls_loc_get_stats(&ctx, &st, true);
	zassert_true(pos.flags & RTLS_POS_FLAG_INIT);
	zassert_equal(st.resets, 1);

	/* sem filtro e com poucas distâncias: ainda não há posição */
	rtls_loc_reset(&ctx);
	make_set(&set, anchors_2d, truth, t + 1600, 0x3, 0.05f, -1);
	zassert_equal(rtls_loc_update(&ctx, &set, &pos), -EAGAIN);
}

/* T4.13 */
ZTEST(loc, test_ekf_reinit_after_jump)
{
	const struct rtls_loc_cfg cfg = cfg_2d(0.05f);
	float truth[3] = {3.0f, 2.0f, TAG_Z_M};
	struct rtls_range_set set;
	struct rtls_position pos;
	struct rtls_loc_stats st;
	int init_round = -1;

	rng_seed(7);
	zassert_ok(rtls_loc_init(&ctx, &cfg));
	for (int k = 0; k < 60; k++) {
		if (k == 30) {
			/*
			 * Salto de 2,8 m: duas âncoras continuam coerentes com a
			 * solução espelhada perto da posição antiga; só o critério de
			 * "metade ou mais rejeitadas" tira o filtro dali.
			 */
			truth[0] = 5.0f;
			truth[1] = 4.0f;
		}
		make_set(&set, anchors_2d, truth, (int64_t)k * CYCLE_MS, 0xF, 0.05f, -1);
		zassert_ok(rtls_loc_update(&ctx, &set, &pos));
		if (k > 0 && (pos.flags & RTLS_POS_FLAG_INIT) && init_round < 0) {
			init_round = k;
		}
	}

	rtls_loc_get_stats(&ctx, &st, false);
	zassert_equal(st.resets, 1);
	zassert_true(init_round > 30 && init_round <= 37, "reiniciou na rodada %d", init_round);
	zassert_true(err_2d(&pos, truth) < 0.10f, "erro final %f m",
		     (double)err_2d(&pos, truth));
}

/* ------------------------------------------------------- NLOS (M8) */

static struct rtls_loc_cfg cfg_nlos(bool weighting)
{
	struct rtls_loc_cfg cfg = cfg_2d(0.05f);

	cfg.nlos_weighting = weighting;
	cfg.nlos_los_db = 6.0f;
	cfg.nlos_nlos_db = 10.0f;
	cfg.nlos_var_gain = 9.0f;
	return cfg;
}

/* T8.6: rampa do fator da variância pelo indicador P_RX - P_FP */
ZTEST(loc, test_nlos_var_factor)
{
	struct rtls_loc_cfg cfg = cfg_nlos(true);
	struct rtls_range r = {.rx_power_cdbm = -7900};

	r.resp_fp_power_cdbm = -7900 - 300; /* 3 dB: LOS */
	zassert_within(rtls_loc_nlos_var_factor(&cfg, &r), 1.0f, 1e-6f);
	r.resp_fp_power_cdbm = -7900 - 800; /* 8 dB: meio da rampa */
	zassert_within(rtls_loc_nlos_var_factor(&cfg, &r), 5.0f, 1e-4f);
	r.resp_fp_power_cdbm = -7900 - 1200; /* 12 dB: NLOS */
	zassert_within(rtls_loc_nlos_var_factor(&cfg, &r), 9.0f, 1e-6f);

	/* sem as potências, ou com a ponderação desligada: fator 1 */
	cfg.nlos_weighting = false;
	zassert_within(rtls_loc_nlos_var_factor(&cfg, &r), 1.0f, 1e-6f);
	cfg.nlos_weighting = true;
	r.rx_power_cdbm = 0;
	r.resp_fp_power_cdbm = 0;
	zassert_within(rtls_loc_nlos_var_factor(&cfg, &r), 1.0f, 1e-6f);

	/* limiares invertidos são configuração inválida */
	cfg.nlos_nlos_db = 5.0f;
	zassert_equal(rtls_loc_init(&ctx, &cfg), -EINVAL);
}

/*
 * RMSE com +12 cm de viés numa âncora sinalizada (indicador 12 dB), abaixo
 * do que o gating rejeita: só a ponderação reduz o peso dela.
 */
static float run_nlos_bias(bool weighting, struct rtls_loc_stats *st)
{
	const struct rtls_loc_cfg cfg = cfg_nlos(weighting);
	const float truth[3] = {3.0f, 2.0f, TAG_Z_M};
	float sum = 0.0f;
	int n = 0;

	rng_seed(8);
	zassert_ok(rtls_loc_init(&ctx, &cfg));
	for (int k = 0; k < 300; k++) {
		struct rtls_range_set set;
		struct rtls_position pos;
		float e;

		make_set(&set, anchors_2d, truth, (int64_t)k * CYCLE_MS, 0xF, 0.05f, -1);
		for (int i = 0; i < set.count; i++) {
			set.ranges[i].resp_fp_power_cdbm = set.ranges[i].rx_power_cdbm - 200;
		}
		set.ranges[2].distance_m += 0.12f;
		set.ranges[2].resp_fp_power_cdbm = set.ranges[2].rx_power_cdbm - 1200;

		zassert_ok(rtls_loc_update(&ctx, &set, &pos));
		e = err_2d(&pos, truth);
		if (k >= 20) {
			sum += e * e;
			n++;
		}
	}

	rtls_loc_get_stats(&ctx, st, false);
	return sqrtf(sum / n);
}

/* T8.6 */
ZTEST(loc, test_nlos_weighting_reduces_bias)
{
	struct rtls_loc_stats st_off, st_on;
	const float off = run_nlos_bias(false, &st_off);
	const float on = run_nlos_bias(true, &st_on);

	zassert_equal(st_off.nlos_weighted, 0);
	zassert_true(st_on.nlos_weighted >= 290, "ponderadas: %u", st_on.nlos_weighted);
	zassert_true(on < 0.8f * off, "RMSE %f com, %f sem", (double)on, (double)off);
	TC_PRINT("T8.6 vies NLOS de 12 cm numa ancora: RMSE %.1f mm sem, %.1f mm com ponderacao\n",
		 (double)(off * 1000.0f), (double)(on * 1000.0f));
}

ZTEST_SUITE(loc, NULL, NULL, NULL, NULL, NULL);
```

## src/test_tdma.c
```c
/*
 * Testes do superquadro TDMA (docs/03-protocolo-uwb.md, seção 5.2): T7.0 em
 * docs/08, seção 10.
 */

#include <errno.h>

#include <zephyr/ztest.h>

#include <rtls/tdma.h>

static const struct rtls_msg_beacon beacon = {
	.type = RTLS_MSG_BEACON,
	.superframe = 100,
	.n_slots = 8,
	.slot_us = 12000,
};

/* T7.0 */
ZTEST(tdma, test_slot_of_and_period)
{
	zassert_equal(rtls_tdma_slot_of(0x1001), 0);
	zassert_equal(rtls_tdma_slot_of(0x1008), 7);
	zassert_equal(rtls_tdma_slot_of(0x1000), -EINVAL);

	/* 4 ms + 8 x 12 ms = 100 ms */
	zassert_equal(rtls_tdma_period_us(8, 12000), 100000);
}

/* T7.0 */
ZTEST(tdma, test_slots_after_beacon)
{
	struct rtls_tdma_sync s = {0};
	int64_t start;

	zassert_equal(rtls_tdma_slot_start(&s, 0, &start), -EAGAIN, "sem beacon, sem slot");

	zassert_ok(rtls_tdma_on_beacon(&s, &beacon, 1000000));
	zassert_true(s.synced);

	zassert_ok(rtls_tdma_slot_start(&s, 0, &start));
	zassert_equal(start, 1004000);
	zassert_ok(rtls_tdma_slot_start(&s, 7, &start));
	zassert_equal(start, 1088000);
	zassert_equal(rtls_tdma_slot_start(&s, 8, &start), -ERANGE);
	zassert_equal(rtls_tdma_slot_start(&s, -1, &start), -ERANGE);

	zassert_equal(rtls_tdma_next_beacon(&s), 1100000);
}

/* T7.0: 3 beacons perdidos seguidos param a tag; um beacon novo volta */
ZTEST(tdma, test_missed_beacons)
{
	struct rtls_tdma_sync s = {0};
	int64_t start;

	zassert_ok(rtls_tdma_on_beacon(&s, &beacon, 0));

	rtls_tdma_on_missed(&s);
	zassert_true(s.synced);
	zassert_equal(s.superframe, 101);
	zassert_ok(rtls_tdma_slot_start(&s, 1, &start));
	zassert_equal(start, 100000 + 4000 + 12000, "slot pelo beacon previsto");

	rtls_tdma_on_missed(&s);
	zassert_true(s.synced);
	rtls_tdma_on_missed(&s);
	zassert_false(s.synced);
	zassert_equal(rtls_tdma_slot_start(&s, 1, &start), -EAGAIN);

	/* sem sincronismo, perder mais não avança nada */
	rtls_tdma_on_missed(&s);
	zassert_equal(s.missed, RTLS_TDMA_MAX_MISSED);

	zassert_ok(rtls_tdma_on_beacon(&s, &beacon, 5000000));
	zassert_true(s.synced);
	zassert_equal(s.missed, 0);
	zassert_ok(rtls_tdma_slot_start(&s, 0, &start));
	zassert_equal(start, 5004000);
}

/* T7.0 */
ZTEST(tdma, test_invalid_beacon)
{
	struct rtls_tdma_sync s = {0};
	struct rtls_msg_beacon bad = beacon;

	bad.n_slots = 0;
	zassert_equal(rtls_tdma_on_beacon(&s, &bad, 0), -EINVAL);
	bad = beacon;
	bad.slot_us = 0;
	zassert_equal(rtls_tdma_on_beacon(&s, &bad, 0), -EINVAL);
	zassert_false(s.synced);
}

ZTEST_SUITE(tdma, NULL, NULL, NULL, NULL, NULL);
```

## src/test_twr_math.c
```c
/*
 * Testes da matemática do DS-TWR (docs/04-algoritmos.md, seção 2).
 */

#include <zephyr/ztest.h>

#include <rtls/twr_math.h>

/* Distância de ~1,57 m em ticks de 15,65 ps. */
#define TRUE_TOF_TICKS 334.0

/*
 * Gera os intervalos de uma rodada ideal com o ToF verdadeiro e relógios com
 * erro relativo e_a (tag) e e_b (âncora). Tempos em ticks "verdadeiros".
 */
static struct rtls_twr_intervals simulate(double tof, double db_true, double da_true, double e_a,
					  double e_b)
{
	struct rtls_twr_intervals iv = {
		.round_a = (uint64_t)((2.0 * tof + db_true) * (1.0 + e_a)),
		.reply_a = (uint64_t)(da_true * (1.0 + e_a)),
		.round_b = (uint64_t)((2.0 * tof + da_true) * (1.0 + e_b)),
		.reply_b = (uint64_t)(db_true * (1.0 + e_b)),
	};

	return iv;
}

ZTEST(twr_math, test_ts_diff_wraps_at_40_bits)
{
	zassert_equal(rtls_dw_ts_diff(1500, 1000), 500);
	zassert_equal(rtls_dw_ts_diff(100, RTLS_DW_TS_MASK - 99), 200);
	zassert_equal(rtls_dw_ts_diff(0, 0), 0);
}

ZTEST(twr_math, test_symmetric_ideal_clocks)
{
	const double us = 63897.6; /* ticks por µs */
	struct rtls_twr_intervals iv =
		simulate(TRUE_TOF_TICKS, 1000.0 * us, 1000.0 * us, 0.0, 0.0);

	zassert_within(rtls_twr_ds_tof(&iv), TRUE_TOF_TICKS, 1.0);
}

ZTEST(twr_math, test_asymmetric_replies_with_clock_drift)
{
	/* Slots diferentes (âncora 3 de 4: Db = 4 ms, Da = 1 ms) e ±20 ppm. */
	const double us = 63897.6;
	struct rtls_twr_intervals iv =
		simulate(TRUE_TOF_TICKS, 4000.0 * us, 1000.0 * us, 20e-6, -15e-6);

	/* Truncamento para inteiro gera até ~1 tick; a deriva em si é desprezível. */
	zassert_within(rtls_twr_ds_tof(&iv), TRUE_TOF_TICKS, 1.0);
}

ZTEST(twr_math, test_tag_intervals_from_timestamps)
{
	struct rtls_twr_intervals iv;

	/* poll_tx próximo do wrap de 40 bits. */
	rtls_twr_tag_intervals(&iv, RTLS_DW_TS_MASK - 10, 100, 500, 7, 9);

	zassert_equal(iv.round_a, 111);
	zassert_equal(iv.reply_a, 400);
	zassert_equal(iv.reply_b, 7);
	zassert_equal(iv.round_b, 9);
}

ZTEST(twr_math, test_invalid_intervals_return_zero)
{
	const struct rtls_twr_intervals iv = {0};

	zassert_equal(rtls_twr_ds_tof(&iv), 0.0);
}

ZTEST(twr_math, test_tof_to_meters)
{
	/* 1 tick ≈ 4,69 mm. */
	zassert_within(rtls_twr_tof_to_m(1.0), 0.004691, 1e-5);
	zassert_within(rtls_twr_tof_to_m(TRUE_TOF_TICKS), 1.5668, 1e-3);
}

ZTEST(twr_math, test_time_unit_conversions)
{
	/* 1 ms = 63 897 600 ticks = 975 UWB µs. */
	zassert_equal(rtls_us_to_dw_ticks(1000), 63897600ULL);
	zassert_equal(rtls_dw_ticks_to_us(63897600ULL), 1000);
	zassert_equal(rtls_dw_ticks_to_us(rtls_us_to_dw_ticks(125)), 125);
	/* truncado: 63 897 ticks ficam abaixo de 1 µs */
	zassert_equal(rtls_dw_ticks_to_us(63897ULL), 0);
	zassert_equal(rtls_us_to_uus(1000), 975);
	zassert_equal(rtls_us_to_uus(0), 0);
}

ZTEST(twr_math, test_slot_time_wraps_at_40_bits)
{
	/* Slot 2 com T_reply = T_slot = 1 ms, partindo de 101 ticks antes do wrap. */
	zassert_equal(rtls_twr_slot_ts(RTLS_DW_TS_MASK - 100, 1000, 1000, 2), 191692699ULL);
	zassert_equal(rtls_twr_slot_ts(0, 1000, 1000, 0), 63897600ULL);
}

/*
 * Correção de viés por RSL (APS011). Valores esperados calculados à mão:
 * RSL(d) = -14,3 + 169,5362 - 218,2284 - 20 log10(d) = -62,992 - 20 log10(d).
 */
ZTEST(twr_math, test_rsl_by_friis_channel_5)
{
	zassert_within(rtls_twr_rsl_dbm(1.0f, 0.0f), -62.99f, 0.02f);
	zassert_within(rtls_twr_rsl_dbm(5.0f, 0.0f), -76.97f, 0.02f);
	zassert_within(rtls_twr_rsl_dbm(10.0f, 0.0f), -82.99f, 0.02f);
	/* Ganho soma direto no RSL. */
	zassert_within(rtls_twr_rsl_dbm(5.0f, 3.0f), -73.97f, 0.02f);
	/* Distância nula ou negativa não gera NaN. */
	zassert_true(rtls_twr_rsl_dbm(0.0f, 0.0f) > -30.0f);
	zassert_true(rtls_twr_rsl_dbm(-1.0f, 0.0f) > -30.0f);
}

ZTEST(twr_math, test_bias_table_points_and_interpolation)
{
	/* Pontos da tabela 2 (PRF 64 MHz). */
	zassert_within(rtls_twr_range_bias_m(-61.0f), -0.110f, 1e-5f);
	zassert_within(rtls_twr_range_bias_m(-77.0f), 0.0f, 1e-5f);
	zassert_within(rtls_twr_range_bias_m(-93.0f), 0.081f, 1e-5f);
	/* Interpolação linear entre -61 (-11,0 cm) e -63 (-10,5 cm). */
	zassert_within(rtls_twr_range_bias_m(-62.0f), -0.1075f, 1e-5f);
	/* Fora da tabela: valor da extremidade. */
	zassert_within(rtls_twr_range_bias_m(-40.0f), -0.110f, 1e-5f);
	zassert_within(rtls_twr_range_bias_m(-110.0f), 0.081f, 1e-5f);
}

ZTEST(twr_math, test_corrected_range)
{
	/* 1 m: RSL -62,99 dBm, viés -10,50 cm -> a distância real é maior. */
	zassert_within(rtls_twr_correct_range(1.0f, 0.0f), 1.1050f, 0.0005f);
	/* 5 m: ponto de calibração, correção praticamente nula. */
	zassert_within(rtls_twr_correct_range(5.0f, 0.0f), 5.0004f, 0.0005f);
	/* 10 m: RSL -82,99 dBm, viés +4,20 cm -> a distância real é menor. */
	zassert_within(rtls_twr_correct_range(10.0f, 0.0f), 9.9580f, 0.0005f);
}

ZTEST_SUITE(twr_math, NULL, NULL, NULL, NULL, NULL);
```
